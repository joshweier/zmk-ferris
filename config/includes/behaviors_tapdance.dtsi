/ {

        behaviors {

		td_wordcap: tdwordcap {
                    compatible = "zmk,behavior-tap-dance";
                    label = "WORDCAP";
                    #binding-cells = <0>;
                    tapping-term-ms = <150>;
                    bindings = <&kp BSPC>, <&caps_word>;
                };

	};
};
