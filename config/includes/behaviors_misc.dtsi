/ {

        behaviors {

		sm: smart_shift {
                    compatible = "zmk,behavior-mod-morph";
                    label = "SMART SHIFT";
                    #binding-cells = <0>;
                    mods = <(MOD_LSFT)>;
                    bindings = <&sk LSFT>, <&caps_word>;
                };

		smn: smart_number {
                    compatible = "zmk,behavior-hold-tap";
                    label = "SMART NUMBER";
                    #binding-cells = <2>;
                    tapping-term-ms = <150>;
                    quick-tap-ms = <150>;
                    flavor = "balanced";
                    bindings = <&sl>, <&num_word>;
                };

	};

};
